## main/Kconfig.projbuild
```kconfig
menu "Beer Monitor - Wi-Fi and iSpindel"

    config BEER_AP_SSID
        string "Local Wi-Fi SSID for iSpindel"
        default "BeerMonitor"

    config BEER_AP_PASSWORD
        string "Local Wi-Fi password (8-63 characters)"
        default "beer-monitor"
        help
            WPA2 password used only by the iSpindel link. Configure the same
            SSID/password in the iSpindel portal. Change the example password.

    config BEER_AP_IP
        string "Local AP IPv4 address (/24 subnet)"
        default "192.168.50.1"
        help
            Choose a subnet different from the external router subnet.
            The iSpindel obtains its IP and the receiver address via DHCP.

    config BEER_ISPINDEL_STALE_SECONDS
        int "Maximum age of an iSpindel reading (seconds)"
        range 35 86400
        default 600
        help
            Used by the display, local interface, recipes and cloud publishing.
            Set longer than the iSpindel send/sleep interval. After 600 seconds
            without a new reading the sensor is considered disconnected.

    config BEER_WIFI_UPLINK_ENABLED
        bool "Connect to an external Wi-Fi network"
        default y

    if BEER_WIFI_UPLINK_ENABLED

    config BEER_WIFI_SSID
        string "External Wi-Fi SSID (2.4 GHz)"
        default ""
        help
            Only the ESP32 connects to this network. Its local AP follows
            the external channel automatically. The iSpindel connects to
            the local AP and rediscovers its channel on each wake cycle.

    config BEER_WIFI_PASSWORD
        string "External Wi-Fi password"
        default ""
        help
            Personal mode: shared network key. Enterprise mode: user password.

    config BEER_WIFI_ENTERPRISE
        bool "Use WPA2-Enterprise (Wi-Fi with username and password)"
        default n
        help
            Enable for institutional 802.1X networks using PEAP/TTLS.
            Leave disabled for a home network using a shared password.
            This is not a browser/captive-portal login.

    config BEER_WIFI_USERNAME
        string "Wi-Fi Enterprise username" if BEER_WIFI_ENTERPRISE
        default ""

    config BEER_WIFI_IDENTITY
        string "Wi-Fi Enterprise identity (empty = username)" if BEER_WIFI_ENTERPRISE
        default ""

    endif
endmenu

menu "Beer Monitor - Temperature control"

    config BEER_CONTROL_ENABLED
        bool "Enable temperature control at boot"
        default y
        help
            Controls the local DS18B20 temperature, independently of Wi-Fi,
            RTC, iSpindel and cloud availability. Both outputs start off.

    config BEER_CONTROL_TARGET_CENTIC
        int "Initial target temperature (hundredths of Celsius)"
        range -500 4000
        default 1800
        help
            1800 means 18.00 C. Target +/- differentials must fit inside the
            minimum/maximum limits below. Invalid combinations keep outputs off.

    config BEER_CONTROL_HEATING_DIFF_CENTIC
        int "Heating differential (hundredths of Celsius)"
        range 10 500
        default 50

    config BEER_CONTROL_COOLING_DIFF_CENTIC
        int "Cooling differential (hundredths of Celsius)"
        range 10 500
        default 50

    config BEER_CONTROL_COMPRESSOR_OFF_SECONDS
        int "Minimum compressor off time, including boot (seconds)"
        range 300 3600
        default 300
        help
            Set according to the refrigerator manufacturer. Never bypassed by
            target changes, sensor recovery or disabling/re-enabling control.

    config BEER_CONTROL_COMPRESSOR_ON_SECONDS
        int "Minimum compressor on time (seconds)"
        range 300 3600
        default 300
        help
            Keeps cooling on for at least this duration even after reaching
            the target. Sensor/configuration/output faults and explicitly
            disabling control still turn the outputs off immediately.

    config BEER_CONTROL_CHANGEOVER_SECONDS
        int "Both outputs off before switching heating/cooling (seconds)"
        range 1 300
        default 30

    config BEER_CONTROL_SENSOR_MAX_AGE_MS
        int "Maximum age of the local temperature sample (milliseconds)"
        range 3000 10000
        default 5000
        help
            Invalid, missing, out-of-range or expired samples turn both relays
            off. Valid samples automatically restore control with all delays.

    config BEER_CONTROL_MIN_CENTIC
        int "Minimum valid process temperature (hundredths of Celsius)"
        range -5500 12500
        default -500

    config BEER_CONTROL_MAX_CENTIC
        int "Maximum valid process temperature (hundredths of Celsius)"
        range -5500 12500
        default 4000
endmenu

menu "Beer Monitor - Local recipe interface"
    config BEER_CAPTIVE_PORTAL_ENABLED
        bool "Offer recipe page when a device joins the local Wi-Fi"
        default y
        help
            Local AP DNS and HTTP captive portal probes. The operating system
            may open the page or offer a sign-in notification. Direct access
            by IP always remains available. No HTTPS interception, internet
            forwarding, or changes to the STA DNS used for cloud publishing.

    config BEER_LOCAL_UI_PASSWORD
        string "Local interface password (empty = local AP Wi-Fi password)"
        default ""
        help
            8-63 characters. Used only on the local AP interface, never sent
            to the MQTT broker or logged. Empty uses BEER_AP_PASSWORD. This HTTP UI
            relies on the protected local WPA2 network and rejects requests
            from the uplink, foreign origins and unrelated Host headers.
endmenu

menu "Beer Monitor - Fermentation recipe"
    config BEER_RECIPE_START_EMBEDDED
        bool "Start embedded recipes/exemplo.json when no saved run exists"
        default n
        help
            Explicit opt-in for the example recipe. Existing running/completed/
            cancelled runs in NVS take precedence. A saved active run resumes
            regardless of this option. Recipe time counts powered operation,
            starting at entry to each step; maximum days always overrides
            absent, invalid or unchanged gravity. Final temperature is held.
endmenu

menu "Beer Monitor - MQTT broker"
    config BEER_LOCAL_MQTT
        bool "Enable MQTT telemetry and recipe commands"
        depends on BEER_WIFI_UPLINK_ENABLED
        default y
        help
            Uses the external Wi-Fi for the MQTT broker. Empty broker settings
            leave the controller and local interface available.

    if BEER_LOCAL_MQTT

    config BEER_MQTT_URI
        string "Broker URI"
        default ""
        help
            Use mqtt://PC_LAN_IP:18883 on the local network. For remote brokers,
            use mqtts:// or wss:// with a trusted certificate. Use the path
            configured by the reverse proxy for WSS. Keep credentials out of the URI.

    config BEER_MQTT_DEVICE
        string "MQTT device identifier and username"
        default "fermentador01"
        help
            Up to 40 lowercase letters, digits and hyphens. Start with
            a letter or digit. Use the identifier registered on the server.

    config BEER_MQTT_PASSWORD
        string "MQTT device password"
        default ""
        help
            Stored in the local sdkconfig and firmware. Never logged.

    config BEER_MQTT_INTERVAL_SECONDS
        int "Telemetry interval (seconds)"
        range 5 3600
        default 15
    endif
endmenu
```
